## meta-evb/meta-evb-aspeed/meta-evb-ast2700/conf/machine/evb-ast2700-emmc.conf
```bitbake
require conf/machine/include/ast2700.inc
include conf/machine/include/obmc-evb-common.inc
require conf/distro/include/phosphor-mmc.inc

# Kernel Build Settings
KERNEL_DEVICETREE = "aspeed/ast2700-evb.dtb"
KBUILD_DEFCONFIG = "aspeed_g7_defconfig"

# CALIPTRA Settings
CALIPTRA_FW_BINARY = "ast2700-caliptra-fw.bin"

# BootMCU Build Settings
BOOTMCU_MACHINE = "ibex-ast2700_defconfig"
BOOTMCU_FW_BINARY = "ast2700-ibex-spl.bin"

# U-Boot Build Settings
UBOOT_MACHINE = "evb-ast2700_defconfig"
UBOOT_DEVICETREE = "ast2700-evb"
UBOOT_FITIMAGE_ENABLE = "1"

IMAGE_FSTYPES = " wic.gz mmc-ext4-tar"

# eMMC/UFS partition size
FLASH_CALIPTRA_OFFSET = "0"
FLASH_CALIPTRA_SIZE = "128"
FLASH_BOOTMCU_OFFSET = "128"
FLASH_BOOTMCU_SIZE = "896"
FLASH_UBOOT_OFFSET = "1024"
MMC_UBOOT_SIZE = "4096"
MMC_BOOT_PARTITION_SIZE = "24576"

include conf/distro/include/mctp.inc
```

## meta-evb/meta-evb-aspeed/meta-evb-ast2700/conf/machine/evb-ast2700.conf
```bitbake
require conf/machine/include/ast2700.inc
include conf/machine/include/obmc-evb-common.inc

# Kernel Build Settings
KERNEL_DEVICETREE = "aspeed/ast2700-evb.dtb"
KBUILD_DEFCONFIG = "aspeed_g7_defconfig"

# CALIPTRA Settings
CALIPTRA_FW_BINARY = "ast2700-caliptra-fw.bin"

# BootMCU Build Settings
BOOTMCU_MACHINE = "ibex-ast2700_defconfig"
BOOTMCU_FW_BINARY = "ast2700-ibex-spl.bin"

# U-Boot Build Settings
UBOOT_MACHINE = "evb-ast2700_defconfig"
UBOOT_DEVICETREE = "ast2700-evb"
UBOOT_FITIMAGE_ENABLE = "1"

SERIAL_CONSOLES = "115200;ttyS12"

# AST2700 EVB has 128MB SPI flash
FLASH_SIZE = "131072"
FLASH_CALIPTRA_OFFSET:flash-131072 = "0"
FLASH_CALIPTRA_SIZE:flash-131072 = "128"
FLASH_BOOTMCU_OFFSET:flash-131072 = "128"
FLASH_BOOTMCU_SIZE:flash-131072 = "896"
FLASH_UBOOT_OFFSET:flash-131072 = "1024"
FLASH_UBOOT_ENV_OFFSET:flash-131072 = "4096"
FLASH_KERNEL_OFFSET:flash-131072 = "4224"
FLASH_ROFS_OFFSET:flash-131072 = "13440"
FLASH_RWFS_OFFSET:flash-131072 = "98304"

include conf/distro/include/mctp.inc
```
